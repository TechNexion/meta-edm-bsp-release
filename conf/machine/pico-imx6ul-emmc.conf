## conf/machine/pico-imx6ul-emmc.conf
```bitbake
#@TYPE: Machine
#@NAME: pico-imx6ul-emmc
#@SOC: i.MX6UL
#@DESCRIPTION: Machine configuration for pico-imx6ul

include conf/machine/include/imx-base.inc
include conf/machine/include/tune-cortexa7.inc
include conf/machine/include/imx6ul-common.inc

SOC_FAMILY = "mx6ul"

PREFERRED_PROVIDER_u-boot = "u-boot-edm"
PREFERRED_PROVIDER_u-boot_mx6 = "u-boot-edm"
PREFERRED_PROVIDER_virtual/bootloader = "u-boot-edm"
PREFERRED_PROVIDER_virtual/bootloader_mx6 = "u-boot-edm"
UBOOT_MAKE_TARGET = ""
UBOOT_SUFFIX = "img"
SPL_BINARY = "SPL"
UBOOT_MACHINE = "picosom-imx6ul_spl_defconfig"

# Ensure uEnv.txt will be available at rootfs time
do_rootfs[depends] += "u-boot-uenv:do_deploy"

UENV_FILENAME = "uEnv.txt"
BOOT_SCRIPTS = "${UENV_FILENAME}:uEnv.txt"

PREFERRED_PROVIDER_virtual/kernel ?= "linux-tn-imx"
PREFERRED_PROVIDER_virtual/kernel_mx6ul = "linux-tn-imx"

KERNEL_DEVICETREE = "imx6ul-pico_hobbit.dtb imx6ul-pico_dwarf.dtb \
					 imx6ul-pico_nymph.dtb imx6ul-pico_pi.dtb"

KERNEL_IMAGETYPE = "zImage"

MACHINE_FEATURES += "bluetooth pci wifi touchscreen"

MACHINE_EXTRA_RRECOMMENDS += " \
  firmware-bcmdhd \
  broadcom-bluetooth \
  openssh-sftp-server \
  libsocketcan \
  bash hostapd dnsmasq haveged create-ap iptables \
"

SERIAL_CONSOLE = "115200 ttymxc5"
```

## conf/machine/pico-imx7.conf
```bitbake
#@TYPE: Machine
#@NAME: pico-imx7
#@SOC: i.MX7D
#@DESCRIPTION: Machine configuration for pico-imx7

include conf/machine/include/imx-base.inc
include conf/machine/include/tune-cortexa7.inc

SOC_FAMILY = "mx7:mx7d"

PREFERRED_PROVIDER_u-boot = "u-boot-edm"
PREFERRED_PROVIDER_u-boot_mx6 = "u-boot-edm"
PREFERRED_PROVIDER_virtual/bootloader = "u-boot-edm"
PREFERRED_PROVIDER_virtual/bootloader_mx6 = "u-boot-edm"
UBOOT_MAKE_TARGET = ""
UBOOT_SUFFIX = "img"
SPL_BINARY = "SPL"
UBOOT_MACHINE = "pico-imx7d_spl_defconfig"

# Ensure uEnv.txt will be available at rootfs time
do_rootfs[depends] += "u-boot-uenv:do_deploy"

UENV_FILENAME = "uEnv.txt"
BOOT_SCRIPTS = "${UENV_FILENAME}:uEnv.txt"

PREFERRED_PROVIDER_virtual/kernel ?= "linux-tn-imx"
PREFERRED_PROVIDER_virtual/kernel_mx7 = "linux-tn-imx"

KERNEL_DEVICETREE = "imx7d-pico_dwarf.dtb imx7d-pico_hobbit.dtb \
					 imx7d-pico_nymph.dtb imx7d-pico_pi.dtb"

KERNEL_IMAGETYPE = "zImage"

MACHINE_FEATURES += "bluetooth pci wifi touchscreen"

MACHINE_EXTRA_RRECOMMENDS += " \
  firmware-bcmdhd \
  broadcom-bluetooth \
  openssh-sftp-server \
  libsocketcan \
  bash hostapd dnsmasq haveged create-ap iptables \
  iperf \
"

SERIAL_CONSOLE = "115200 ttymxc4"
```

## conf/machine/tek3-imx6.conf
```bitbake
#@TYPE: Machine
#@NAME: Technexion TEK3-IMX6
#@SOC: i.MX6Q/DL/solo
#@DESCRIPTION: Machine configuration for TEK3-IMX6

include conf/machine/include/imx-base.inc
include conf/machine/include/tune-cortexa9.inc

SOC_FAMILY = "mx6:mx6dl:mx6q"

PREFERRED_PROVIDER_u-boot = "u-boot-edm"
PREFERRED_PROVIDER_virtual/bootloader = "u-boot-edm"
PREFERRED_PROVIDER_u-boot_mx6 = "u-boot-edm"
UBOOT_MAKE_TARGET = ""
UBOOT_SUFFIX = "img"
SPL_BINARY = "SPL"
UBOOT_MACHINE = "edm-cf-imx6_defconfig"

UENV_FILENAME = "uEnv_${DISPLAY_TYPE}.txt"
BOOT_SCRIPTS = "${UENV_FILENAME}:uEnv.txt"

PREFERRED_PROVIDER_virtual/kernel ?= "linux-tek3-imx6"
PREFERRED_PROVIDER_virtual/kernel_mx6 = "linux-tek3-imx6"

KERNEL_DEVICETREE = "imx6q-tek3.dtb \
                     imx6dl-tek3.dtb"
KERNEL_IMAGETYPE = "zImage"

MACHINE_FEATURES += "pci touchscreen"

MACHINE_EXTRA_RRECOMMENDS += " \
  openssh-sftp-server \
  libsocketcan \
"

SERIAL_CONSOLE = "115200 ttymxc0"
```

## conf/machine/tep1-imx6ul.conf
```bitbake
#@TYPE: Machine
#@NAME: tep3-imx6ul
#@SOC: i.MX6UL
#@DESCRIPTION: Machine configuration for tep3-imx6ul

include conf/machine/include/imx-base.inc
include conf/machine/include/tune-cortexa7.inc
include conf/machine/include/imx6ul-common.inc

SOC_FAMILY = "mx6ul"

PREFERRED_PROVIDER_u-boot = "u-boot-edm"
PREFERRED_PROVIDER_u-boot_mx6 = "u-boot-edm"
PREFERRED_PROVIDER_virtual/bootloader = "u-boot-edm"
PREFERRED_PROVIDER_virtual/bootloader_mx6 = "u-boot-edm"
UBOOT_MAKE_TARGET = ""
UBOOT_SUFFIX = "img"
SPL_BINARY = "SPL"
UBOOT_MACHINE = "tep1-imx6ul_defconfig"

PREFERRED_PROVIDER_virtual/kernel ?= "linux-tn-imx"
PREFERRED_PROVIDER_virtual/kernel_mx6ul = "linux-tn-imx"

KERNEL_DEVICETREE = "imx6ul-tep1.dtb"

KERNEL_IMAGETYPE = "zImage"

MACHINE_FEATURES += "touchscreen"

MACHINE_EXTRA_RRECOMMENDS += " \
  openssh-sftp-server \
  libsocketcan \
"

SERIAL_CONSOLE = "115200 ttymxc1"
```

## conf/machine/tep1-imx7.conf
```bitbake
#@TYPE: Machine
#@NAME: tep1-imx7
#@SOC: i.MX7D
#@DESCRIPTION: Machine configuration for tep1-imx7

include conf/machine/include/imx-base.inc
include conf/machine/include/tune-cortexa7.inc

SOC_FAMILY = "mx7:mx7d"

PREFERRED_PROVIDER_u-boot = "u-boot-edm"
PREFERRED_PROVIDER_u-boot_mx6 = "u-boot-edm"
PREFERRED_PROVIDER_virtual/bootloader = "u-boot-edm"
PREFERRED_PROVIDER_virtual/bootloader_mx6 = "u-boot-edm"
UBOOT_MAKE_TARGET = ""
UBOOT_SUFFIX = "img"
SPL_BINARY = "SPL"
UBOOT_MACHINE = "tep1-imx7d_spl_defconfig"

# Ensure uEnv.txt will be available at rootfs time
#do_rootfs[depends] += "u-boot-uenv:do_deploy"

#UENV_FILENAME = "uEnv.txt"
#BOOT_SCRIPTS = "${UENV_FILENAME}:uEnv.txt"

PREFERRED_PROVIDER_virtual/kernel ?= "linux-tn-imx"
PREFERRED_PROVIDER_virtual/kernel_mx7 = "linux-tn-imx"

KERNEL_DEVICETREE = "imx7d-tep1.dtb"

KERNEL_IMAGETYPE = "zImage"

MACHINE_FEATURES += "touchscreen"

MACHINE_EXTRA_RRECOMMENDS += " \
  openssh-sftp-server \
  libsocketcan \
  iperf \
"

SERIAL_CONSOLE = "115200 ttymxc1"
```

## conf/machine/wand-pi-8m.conf
```bitbake
#@TYPE: Machine
#@NAME: WAND-PI-8M
#@SOC: i.MX8MQ
#@DESCRIPTION: Machine configuration for WAND-PI-8M
#@MAINTAINER: Richard Hu <hakahu@gmail.com>

MACHINEOVERRIDES =. "mx8:mx8mq:"

require conf/machine/include/imx-base.inc
require conf/machine/include/arm/arch-arm64.inc

MACHINE_FEATURES += " pci wifi bluetooth"

MACHINE_SOCARCH_FILTER_append_mx8mq = "virtual/libopenvg virtual/libgles1 virtual/libgles2 virtual/egl virtual/mesa virtual/libgl virtual/libg2d"

PREFERRED_PROVIDER_virtual/kernel ?= "linux-wand-imx"
PREFERRED_PROVIDER_virtual/kernel_mx8mq = "linux-wand-imx"

KERNEL_DEVICETREE ?= "freescale/wand-pi-8m.dtb"

#IMAGE_M4LOADER = "imx-m4-demos"
#IMAGE_M4 = "imx8mq_m4_TCM_hello_world.bin imx8mq_m4_TCM_rpmsg_lite_pingpong_rtos_linux_remote.bin imx8mq_m4_TCM_rpmsg_lite_str_echo_rtos.bin"

PREFERRED_PROVIDER_u-boot = "u-boot-wand"
PREFERRED_PROVIDER_u-boot_mx8mq = "u-boot-wand"
PREFERRED_PROVIDER_virtual/bootloader = "u-boot-wand"
PREFERRED_PROVIDER_virtual/bootloader_mx8mq = "u-boot-wand"

UBOOT_CONFIG ??= "sd"
UBOOT_CONFIG[sd] = "wand-pi-8m_defconfig,sdcard"
UBOOT_CONFIG[mfgtool] = "wand-pi-8m_defconfig"
SPL_BINARY = "spl/u-boot-spl.bin"

# Set DDR FIRMWARE
DDR_FIRMWARE_NAME = "lpddr4_pmu_train_1d_imem.bin lpddr4_pmu_train_1d_dmem.bin lpddr4_pmu_train_2d_imem.bin lpddr4_pmu_train_2d_dmem.bin"

# Set u-boot DTB
UBOOT_DTB_NAME = "wand-pi-8m.dtb"

# Set imx-mkimage boot target
IMXBOOT_TARGETS = "flash_evk flash_evk_no_hdmi"

# Set Serial console
SERIAL_CONSOLE = "115200 ttymxc0"

IMAGE_BOOTLOADER = "imx-boot"

BOOT_SPACE = "32768"

LOADADDR = ""
UBOOT_SUFFIX = "bin"
UBOOT_MAKE_TARGET = ""
IMX_BOOT_SEEK = "33"
```

## conf/machine/wandboard-imx6.conf
```bitbake
#@TYPE: Machine
#@NAME: edm1-cf-imx6
#@SOC: i.MX6Q/Dual/DualLite/Solo
#@DESCRIPTION: Machine configuration for edm1-cf-imx6

include conf/machine/include/imx-base.inc
include conf/machine/include/tune-cortexa9.inc

SOC_FAMILY = "mx6:mx6dl:mx6q"

PREFERRED_PROVIDER_u-boot = "u-boot-edm"
PREFERRED_PROVIDER_u-boot_mx6 = "u-boot-edm"
PREFERRED_PROVIDER_virtual/bootloader = "u-boot-edm"
PREFERRED_PROVIDER_virtual/bootloader_mx6 = "u-boot-edm"
UBOOT_MAKE_TARGET = ""
UBOOT_SUFFIX = "img"
SPL_BINARY = "SPL"
UBOOT_MACHINE = "wandboard_defconfig"

# Ensure uEnv.txt will be available at rootfs time
do_rootfs[depends] += "u-boot-uenv:do_deploy"

UENV_FILENAME = "uEnv.txt"
BOOT_SCRIPTS = "${UENV_FILENAME}:uEnv.txt"

PREFERRED_PROVIDER_virtual/kernel ?= "linux-tn-imx"
PREFERRED_PROVIDER_virtual/kernel_mx6 = "linux-tn-imx"

KERNEL_DEVICETREE = "imx6dl-wandboard-revb1.dtb imx6q-wandboard-revb1.dtb \
                     imx6dl-wandboard-revc1.dtb imx6q-wandboard-revc1.dtb \
                     imx6dl-wandboard-revd1.dtb imx6q-wandboard-revd1.dtb imx6qp-wandboard-revd1.dtb"

KERNEL_IMAGETYPE = "zImage"

MACHINE_FEATURES += "bluetooth pci wifi touchscreen"

MACHINE_EXTRA_RRECOMMENDS += " \
  firmware-legacy \
  firmware-bcmdhd \
  broadcom-bluetooth \
  openssh-sftp-server \
  libsocketcan \
  bash hostapd dnsmasq haveged create-ap iptables \
  iperf \
"

SERIAL_CONSOLE = "115200 ttymxc0"
```
